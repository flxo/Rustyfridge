DO t32/selectFile.cmm
IF ("&operationStatus"=="OK")
(
	Data.LOAD.ELF "&currentFile"
)
