Data.SUM 0x0--0x1B /Long         ;Calculate checksum of all (other) vectors
Data.Set 0x1C %Long -Data.SUM()  ;Write the 2's complement in reserved vector's spot
