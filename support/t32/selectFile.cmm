IF ("&currentFileFolder"!="")
(
	PRINT "&currentFileFolder"
	DIALOG.File "&currentFileFolder/*.&selectFileExtension"
)
ELSE
(
	DIALOG.File "./*.&selectFileExtension"
)
ENTRY %LINE &lastSelectedFile

IF ("&lastSelectedFile"!="")
(
	&currentFile="&lastSelectedFile"
	&currentFileFolder=OS.FILE.PATH("&lastSelectedFile")
	&operationStatus="OK"
)
ELSE
(
	PRINT "No file was selected."
	&operationStatus="SKIPPED"
)

PRINT "&currentFile"
