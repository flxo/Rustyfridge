// T32 Wed Sep 23 15:59:30 2015

 B::
 
 TOOLBAR ON
 STATUSBAR ON
 FramePOS 320.0,0.0,,,Maximized
 WinPAGE.RESet
 
 WinPAGE.Create P000
 
 WinCLEAR
 WinPOS 160.0 39.125 157. 34. 26. 1. W002
 WinTABS 13. 16. 0. 0. 0. 0. 0.
 wl.Break.List
 
 WinPOS 160.0 0.0 157. 35. 0. 1. W000
 WinTABS 26. 26.
 wl.sYmbol.Browse
 
 WinPOS 0.0 0.0 157. 73. 16. 1. W003
 WinTABS 10. 10. 25. 62.
 wl.list.Hll
 
 WinPAGE.select P000
 
 ENDDO
